#include "IRRemoteControl.h"
#include <Keypad.h>
IRSend irSend;
String command;
const PROGMEM unsigned int volumeUp [] = {2392, 636, 556, 640, 1156, 636, 556, 640, 560, 636, 1152, 640, 556,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 640, 556};
const PROGMEM unsigned int volumeDown [] = {2392, 640, 1152, 640, 1156, 596, 596, 600, 596, 640, 1152, 640, 556,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 584, 556};
const PROGMEM unsigned int television [] = {420, 33696, 416, 33692, 420, 33680, 416, 280, 156, 33156, 2392, 636, 1156,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 636, 556};
const PROGMEM unsigned int fibe[] = {424, 292, 136, 308, 136, 648, 136, 476, 140, 472, 136, 312, 136,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 608, 588};
const PROGMEM unsigned int one [] = {420, 4116, 88, 29516, 420, 33720, 420, 280, 152, 33276, 420, 33704, 424,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 476, 140};
const PROGMEM unsigned int two [] = {400, 320, 92, 356, 92, 688, 92, 524, 92, 520, 92, 356, 92,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 692, 92};
const PROGMEM unsigned int three [] = {424, 296, 132, 312, 136, 648, 132, 480, 132, 480, 132, 316, 132,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 816, 132};
const PROGMEM unsigned int four [] = {424, 296, 128, 320, 132, 644, 136, 480, 132, 480, 136, 312, 132,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 312, 136};
const PROGMEM unsigned int five [] = {428, 292, 136, 308, 136, 644, 136, 480, 136, 476, 136, 308, 140,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 476, 136};
const PROGMEM unsigned int six [] = {428, 292, 136, 308, 140, 640, 140, 472, 140, 476, 136, 308, 140,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 640, 140};
const PROGMEM unsigned int seven [] = {424, 296, 136, 312, 136, 644, 136, 476, 136, 480, 132, 312, 136,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 812, 136};
const PROGMEM unsigned int eight [] = {428, 292, 136, 308, 136, 644, 140, 472, 140, 476, 136, 308, 140,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 308, 136};
const PROGMEM unsigned int nine [] = {424, 292, 136, 308, 136, 648, 136, 476, 136, 476, 136, 312, 136,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 476, 136};
const PROGMEM unsigned int zero [] = {424, 292, 136, 308, 140, 640, 140, 476, 136, 476, 136, 312, 136,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 312, 136};
const PROGMEM unsigned int mute [] = {2400, 608, 588, 608, 588, 608, 1184, 608, 588, 608, 1184, 608, 588,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 612, 584};
const PROGMEM unsigned int lastChannel [] = {416, 280, 152, 33264, 424, 34988, 416, 280, 156, 33264, 420, 768, 92,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 648, 136};
const PROGMEM unsigned int chose [] = {424, 296, 128, 316, 132, 648, 128, 488, 128, 484, 132, 316, 124,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 280, 156};
const PROGMEM unsigned int right [] = {420, 276, 168, 300, 132, 648, 132, 480, 136, 476, 140, 308, 136,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 808, 136};
const PROGMEM unsigned int down [] = {2392, 612, 1176, 612, 580, 612, 1180, 612, 580, 612, 1176, 612, 1180,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 608, 584};
const PROGMEM unsigned int up [] = {2396, 608, 584, 608, 584, 608, 1180, 612, 584, 608, 1180, 608, 1180,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 608, 584};
const PROGMEM unsigned int input [] = {2388, 596, 1192, 640, 552, 640, 1152, 596, 596, 636, 556, 640, 1152,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 636, 556};
const PROGMEM unsigned int inputselect [] = {2388, 636, 1156, 632, 560, 636, 1152, 636, 556, 636, 556, 636, 1156,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 560, 552};
unsigned int temp [150];
const int FREQ_KHZ = 38;
const byte ROWS = 4;
const byte COLS = 4;

char hexaKeys[ROWS][COLS] = {
  {'1', '2', '3', 'A'},
  {'4', '5', '6', 'B'},
  {'7', '8', '9', 'C'},
  {'*', '0', '#', 'D'}
};
byte rowPins[ROWS] = {12, 11, 10, 9};
byte colPins[COLS] = {8, 7, 6, 5};
Keypad keypad = Keypad(makeKeymap(hexaKeys), rowPins, colPins, ROWS, COLS);
char channelarray [13][4] = {{'1', '4', '0', '0'}, {'1', '4', '0', '1'}, {'1', '4', '0', '2'}, {'1', '4', '0', '3'}, {'1', '4', '0', '4'}, {'1', '4', '0', '5'}, {'1', '4', '0', '6'}, {'1', '4', '0', '7'}, {'1', '4', '0', '8'}
  , {'1', '5', '0', '0'}, {'1', '5', '0', '1'}, {'1', '5', '0', '2'}, {'1', '2', '0', '5'}
};
String channels [13] = {"zero", "one", "two", "three", "four", "five", "six", "seven", "eight", "nine", "ten", "eleven", "twelve"};
int k = 0;
void setup()
{
  Serial.begin(9600);
  pinMode(4, OUTPUT );
  digitalWrite(4, LOW);
}

void loop() {
  char key = keypad.getKey();
  int  newchannel = 36;
  if (key == 'A') {
    Serial.println("What channel would you like to change?");
    k = 1;
  } else if (key == 'B') {
    k = 0;
    Serial.println("Okay, ending the process");
  }
  if (k == 1  ) {
    if ( key != '\0' && key != 'B' && key != 'A') {
      char old [4];
      for (int i = 0; i < 4; i++) {
        key = '\0';
        while (key == '\0') {
          key = keypad.getKey();
        }
        if (key != 'A' && key != 'B') {
          old[i] = key;
          Serial.println(key);
        } else if (key == 'A') {
          k = 1;
          i = 90;
        } else if (key == 'B') {
          k = 0;
          i = 78;
        }
      }
      int j = 0;
      for (int i = 0; i < 13; i++) {
        j = 0;
        for (int k = 0; k < 4; k++) {
          if (old[k] == channelarray[i][k]) {
            j++;
            if (j == 4) {
              newchannel = i;
            }
          }
        }
        if (newchannel == i) {
          newchannel = newchannel;
          i = 17;
        }
      }
      if (j != 4 && key == 'A') {
        Serial.println("What channel would you like to change?");
      } else if (j != 4 && key == 'B') {
        Serial.println("Ending process!");
      } else  if (j != 4) {
        Serial.println("This is not a channel currently on the VAR");
      } else {
        Serial.println("What channel would you like to replace this one with?");
        j = 0;
        char replacement [4];
        for (int i = 0; i < 4; i++) {
          key = '\0';
          while (key == '\0') {
            key = keypad.getKey();
          }
          if (key != 'A' && key != 'B') {
            replacement[i] = key;
            Serial.println(replacement[i]);
          } else if (key == 'A') {
            k = 1;
            i = 90;
          } else if (key == 'B') {
            k = 0;
            i = 78;
          }
        }
        int m = 0;
        for (int i = 0; i < 13; i++) {
          for (int j = 0; j < 4; j++) {
            if (replacement[k] == channelarray[i][k]) {
              m++;
            }
          }
        }
        if (m == 4 && key == 'A') {
          Serial.println("What channel would you like to change?");
        } else if (m >= 0 && key == 'B') {
          Serial.println("Ending process!");
          k = 0;
        } else if (m == 4) {
          Serial.println("You already have this channel on the VAR");
        } else {
          for (int j = 0; j < 4; j++) {
            channelarray[newchannel][j] = replacement[j];
          }
          Serial.println("Channel added!");
        }
      }
    }
  }
  if (Serial.available() > 0)
  {
    command = Serial.readString();
    Serial.println(command);
    if (command == "volume up") {
      int rand = random(1, 15);
      storage(volumeUp);
      for (int i = 0; i < rand; i++) {
        irSend.sendRaw(temp, 104, FREQ_KHZ, false);
        delay(50);
      }
    } else if (command == "volume down") {
      int rando = random(1, 15);
      storage(volumeDown);
      for (int i = 0; i < rando; i++) {
        irSend.sendRaw(temp, 104, FREQ_KHZ, false);
        delay(50);
      }
    } else if (command == "on"||command =="off") {
      storage(television);
      irSend.sendRaw(temp, 104, FREQ_KHZ, false);
      delay(200);
      storage(fibe);
      irSend.sendRaw(temp, 104, FREQ_KHZ, false);
      delay(200);
    }
    else if (command == "select") {
      storage(fibe);
      irSend.sendRaw(temp, 104, FREQ_KHZ, false);
      delay(200);
    }
    for (int i = 0; i < 13; i++) {
      if (command.equals(channels[i])) {
        for (int j = 0; j < 4; j++) {
          chardecoder(channelarray[i][j]);
          Serial.println(channelarray[i][j]);
        }
      }
    }
    if (command == "volume") {
      storage(mute);
      irSend.sendRaw(temp , 150, FREQ_KHZ, false);
    } else if (command == "go back") {
      storage(lastChannel);
      irSend.sendRaw(temp, 150, FREQ_KHZ, false);
      delay(1000);
      storage(chose);
      irSend.sendRaw(temp, 150, FREQ_KHZ, false);
    } else if (command == "go back twice") {
      storage(lastChannel);
      irSend.sendRaw(temp, 150, FREQ_KHZ, false);
      delay(1000);
      dpad(right);
      storage(chose);
      irSend.sendRaw(temp, 150, FREQ_KHZ, false);
    } else if (command == "go back three") {
      storage(lastChannel);
      irSend.sendRaw(temp, 150, FREQ_KHZ, false);
      delay(1000);
      dpad(right);
      dpad(right);
      storage(chose);
      irSend.sendRaw(temp, 150, FREQ_KHZ, false);
    } else if (command == "go back four") {
      storage(lastChannel);
      irSend.sendRaw(temp, 150, FREQ_KHZ, false);
      delay(1000);
      dpad(right);
      dpad(right);
      dpad(right);
      storage(chose);
      irSend.sendRaw(temp, 150, FREQ_KHZ, false);
    } else if (command == "go back five") {
      storage(lastChannel);
      irSend.sendRaw(temp, 150, FREQ_KHZ, false);
      delay(1000);
      dpad(right);
      dpad(right);
      dpad(right);
      dpad(right);
      storage(chose);
      irSend.sendRaw(temp, 150, FREQ_KHZ, false);
    } else if (command == "in up") {
      storage(input);
      irSend.sendRaw(temp, 150, FREQ_KHZ, false);
      dpad(up);
      storage(inputselect);
      irSend.sendRaw(temp, 150, FREQ_KHZ, false);
    } else if (command == "in down") {
      storage(input);
      irSend.sendRaw(temp, 150, FREQ_KHZ, false);
      dpad(down);
      storage(inputselect);
      irSend.sendRaw(temp, 150, FREQ_KHZ, false);
    } else if (command == "n") {
      //      channel(one, three, one, one);
    }
    Serial.flush();
  }
}
void storage(const unsigned int num[] ) {
  for (byte k = 0; k < 150; k++) {
    temp[k] = pgm_read_word_near(num + k);
  }
}
void channel(const unsigned int n[]) {
  storage(n);
  irSend.sendRaw(temp, 150, FREQ_KHZ, false);
  delay(200);
}
void dpad(int numero[]) {
  storage(numero);
  irSend.sendRaw(temp, 150, FREQ_KHZ, false);
  delay(1000);
}
void chardecoder(char i) {
  if (i == '1') {
    channel(one);
  } else if (i == '2') {
    channel(two);
  } else if (i == '3') {
    channel(three);
  } else if (i == '4') {
    channel(four);
  } else if (i == '5') {
    channel(five);
  } else if (i == '6') {
    channel(six);
  } else if (i == '7') {
    channel(seven);
  } else if (i == '8') {
    channel(eight);
  } else if (i == '9') {
    channel(nine);
  } else if (i == '0') {
    channel(zero);
  }
}
